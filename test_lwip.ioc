# file: test_lwip.ioc
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ADC1.Channel-1\#ChannelRegularConversion=ADC_CHANNEL_0
ADC1.NbrOfConversionFlag=1
ADC1.Rank-1\#ChannelRegularConversion=1
ADC1.SamplingTime-1\#ChannelRegularConversion=ADC_SAMPLETIME_3CYCLES
ADC1.master=1
ADC3.Channel-0\#ChannelRegularConversion=ADC_CHANNEL_7
ADC3.Channel-IN7=ADC_CHANNEL_7
ETH.MACAddr=00\:80\:E1\:00\:00\:07
ETH.MediaInterface=HAL_ETH_RMII_MODE
FMC.CASLatency1=FMC_SDRAM_CAS_LATENCY_3
FMC.ExitSelfRefreshDelay1=7
FMC.LoadToActiveDelay1=2
FMC.RCDDelay1=2
FMC.RPDelay1=2
FMC.RPDelay2=2
FMC.ReadBurst1=FMC_SDRAM_RBURST_ENABLE
FMC.ReadBurst2=FMC_SDRAM_RBURST_ENABLE
FMC.RowCycleDelay1=7
FMC.RowCycleDelay2=7
FMC.SDClockPeriod1=FMC_SDRAM_CLOCK_PERIOD_2
FMC.SDClockPeriod2=FMC_SDRAM_CLOCK_PERIOD_2
FMC.SelfRefreshTime1=4
FMC.WriteRecoveryTime1=3
FREERTOS.BinarySemaphores01=tcpsem,Dynamic,NULL,Available
FREERTOS.Tasks01=defaultTask,0,256,StartDefaultTask,Default,NULL,Dynamic,NULL,NULL;tache_joueur_1,0,256,Fonction_tache_joueur_1,Default,NULL,Dynamic,NULL,NULL;tache_affichage,0,1024,Fonction_tache_affichage,Default,NULL,Dynamic,NULL,NULL
FREERTOS.configUSE_NEWLIB_REENTRANT=1
I2C1.Timing=0x00C0EAFF
I2C3.Timing=0x00C0EAFF
LTDC.ActiveH=272
LTDC.ActiveW=480
LTDC.Alpha_L0=255
LTDC.BlendingFactor1_L0=LTDC_BLENDING_FACTOR1_PAxCA
LTDC.BlendingFactor2_L0=LTDC_BLENDING_FACTOR2_PAxCA
LTDC.FBStartAdress_L0=0xC0000000
LTDC.HBP=13
LTDC.HFP=32
LTDC.HSync=41
LTDC.ImageHeight_L0=272
LTDC.ImageWidth_L0=480
LTDC.Layers=0
LTDC.PixelFormat_L0=LTDC_PIXEL_FORMAT_RGB565
LTDC.VSync=10
LTDC.WindowX1_L0=480
LTDC.WindowY1_L0=272
LWIP.BSP.number=1
LWIP.GATEWAY_ADDRESS=192.168.001.001
LWIP.IP_ADDRESS=192.168.001.100
LWIP.LWIP_DHCP=1
LWIP.LWIP_HTTPD=1
LWIP.LWIP_RAM_HEAP_POINTER=0x20048000
LWIP.MEM_SIZE=10*1024
LWIP.NETMASK_ADDRESS=255.255.255.000
LWIP.Version=v2.1.2_Cube
LWIP0.BSP.STBoard=false
LWIP0.BSP.api=BSP_COMPONENT_DRIVER
LWIP0.BSP.component=LAN8742
LWIP0.BSP.instance=LAN8742
LWIP0.BSP.name=Driver_PHY
LWIP0.BSP.semaphore=S_LAN8742
LWIP0.BSP.solution=LAN8742
Mcu.Family=STM32F7
Mcu.Name=STM32F746NGHx
Mcu.Package=TFBGA216
NVIC.DMA2D_IRQn=true\:5\:0\:false\:false\:true\:true\:true\:true\:true
NVIC.ETH_IRQn=true\:5\:0\:false\:false\:true\:true\:false\:true\:true
NVIC.LTDC_IRQn=true\:5\:0\:false\:false\:true\:true\:true\:true\:true
NVIC.PriorityGroup=NVIC_PRIORITYGROUP_4
NVIC.TIM6_DAC_IRQn=true\:15\:0\:false\:false\:true\:false\:false\:true\:true
NVIC.TimeBase=TIM6_DAC_IRQn
NVIC.TimeBaseIP=TIM6
PA0/WKUP.Signal=ADCx_IN0
PA1.GPIO_Label=RMII_REF_CLK [LAN8742A-CZ-TR_REFCLK0]
PA1.Mode=RMII
PA1.Signal=ETH_REF_CLK
PA11.GPIO_Label=OTG_FS_N
PA11.Signal=USB_OTG_FS_DM
PA12.GPIO_Label=OTG_FS_P
PA12.Signal=USB_OTG_FS_DP
PA13.GPIO_Label=SWDIO
PA13.Mode=Trace_Asynchronous_SW
PA13.Signal=SYS_JTMS-SWDIO
PA14.GPIO_Label=SWCLK
PA14.Mode=Trace_Asynchronous_SW
PA14.Signal=SYS_JTCK-SWCLK
PA15.GPIO_Label=BP2
PA15.Signal=GPIO_Input
PA2.GPIO_Label=RMII_MDIO [LAN8742A-CZ-TR_MDIO]
PA2.Mode=RMII
PA2.Signal=ETH_MDIO
PA3.GPIO_Label=ULPI_D0 [USB3320C-EZK_D0]
PA3.Mode=Host_HS
PA3.Signal=USB_OTG_HS_ULPI_D0
PA4.Signal=COMP_DAC1_group
PA5.GPIO_Label=ULPI_CLK [USB3320C-EZK_CLKOUT]
PA5.Mode=Host_HS
PA5.Signal=USB_OTG_HS_ULPI_CK
PA6.Signal=GPIO_Input
PA7.GPIO_Label=RMII_CRS_DV [LAN8742A-CZ-TR_CRS_DV]
PA7.Mode=RMII
PA7.Signal=ETH_CRS_DV
PA8.GPIO_Label=BP1
PA8.Signal=GPIO_Input
PA9.GPIO_Label=VCP_TX [STM32F103CBT6_PA3]
PA9.GPIO_Mode=GPIO_MODE_AF_PP
PA9.GPIO_PuPd=GPIO_NOPULL
PA9.GPIO_Speed=GPIO_SPEED_FREQ_LOW
PA9.Mode=Asynchronous
PA9.Signal=USART1_TX
PB0.GPIO_Label=ULPI_D1 [USB3320C-EZK_D1]
PB0.Mode=Host_HS
PB0.Signal=USB_OTG_HS_ULPI_D1
PB1.GPIO_Label=ULPI_D2 [USB3320C-EZK_D2]
PB1.Mode=Host_HS
PB1.Signal=USB_OTG_HS_ULPI_D2
PB11.GPIO_Label=ULPI_D4 [USB3320C-EZK_D4]
PB11.Mode=Host_HS
PB11.Signal=USB_OTG_HS_ULPI_D4
PB12.GPIO_Label=ULPI_D5 [USB3320C-EZK_D5]
PB12.Mode=Host_HS
PB12.Signal=USB_OTG_HS_ULPI_D5
PB13.GPIO_Label=ULPI_D6 [USB3320C-EZK_D6]
PB13.Mode=Host_HS
PB13.Signal=USB_OTG_HS_ULPI_D6
PB14.GPIO_Label=ARDUINO MISO/D12
PB14.GPIO_Mode=GPIO_MODE_AF_PP
PB14.GPIO_PuPd=GPIO_NOPULL
PB14.GPIO_Speed=GPIO_SPEED_FREQ_LOW
PB14.Mode=Full_Duplex_Master
PB14.Signal=SPI2_MISO
PB15.GPIO_Label=ARDUINO MOSI/PWM/D11
PB15.GPIO_Mode=GPIO_MODE_AF_PP
PB15.GPIO_PuPd=GPIO_NOPULL
PB15.GPIO_Speed=GPIO_SPEED_FREQ_LOW
PB15.Mode=Full_Duplex_Master
PB15.Signal=SPI2_MOSI
PB2.Signal=QUADSPI_CLK
PB3.Mode=Trace_Asynchronous_SW
PB3.Signal=SYS_JTDO-SWO
PB4.GPIO_Label=LED1
PB4.Signal=GPIO_Output
PB5.GPIO_Label=ULPI_D7 [USB3320C-EZK_D7]
PB5.Mode=Host_HS
PB5.Signal=USB_OTG_HS_ULPI_D7
PB6.GPIO_Label=QSPI_NCS [N25Q128A13EF840E_S]
PB6.Signal=QUADSPI_BK1_NCS
PB7.GPIO_Label=VCP_RX [STM32F103CBT6_PA2]
PB7.GPIO_Mode=GPIO_MODE_AF_PP
PB7.GPIO_PuPd=GPIO_NOPULL
PB7.GPIO_Speed=GPIO_SPEED_FREQ_LOW
PB7.Mode=Asynchronous
PB7.Signal=USART1_RX
PB8.Mode=I2C
PB8.Signal=I2C1_SCL
PB9.Mode=I2C
PB9.Signal=I2C1_SDA
PC0.GPIO_Label=ULPI_STP [USB3320C-EZK_STP]
PC0.Mode=Host_HS
PC0.Signal=USB_OTG_HS_ULPI_STP
PC1.GPIO_Label=RMII_MDC [LAN8742A-CZ-TR_MDC]
PC1.Mode=RMII
PC1.Signal=ETH_MDC
PC10.GPIO_Label=SDMMC_D2
PC10.Signal=SDMMC1_D2
PC11.GPIO_Label=SDMMC_D3
PC11.Signal=SDMMC1_D3
PC12.GPIO_Label=SDMMC_CK
PC12.Signal=SDMMC1_CK
PC13.GPIO_Label=uSD_Detect
PC13.Signal=GPIO_Input
PC14/OSC32_IN.GPIO_Label=RCC_OSC32_IN
PC14/OSC32_IN.Mode=LSE-External-Oscillator
PC14/OSC32_IN.Signal=RCC_OSC32_IN
PC15/OSC32_OUT.GPIO_Label=RCC_OSC32_OUT
PC15/OSC32_OUT.Mode=LSE-External-Oscillator
PC15/OSC32_OUT.Signal=RCC_OSC32_OUT
PC2.GPIO_Label=ULPI_DIR [USB3320C-EZK_DIR]
PC2.Mode=Host_HS
PC2.Signal=USB_OTG_HS_ULPI_DIR
PC3.GPIO_Label=FMC_SDCKE0 [MT48LC4M32B2B5-6A_CKE]
PC3.Mode=SdramChipSelect1_1
PC3.Signal=FMC_SDCKE0
PC4.GPIO_Label=RMII_RXD0 [LAN8742A-CZ-TR_RXD0]
PC4.Mode=RMII
PC4.Signal=ETH_RXD0
PC5.GPIO_Label=RMII_RXD1 [LAN8742A-CZ-TR_RXD1]
PC5.Mode=RMII
PC5.Signal=ETH_RXD1
PC6.GPIO_Label=ARDUINO TX/D1
PC6.Mode=Asynchronous
PC6.Signal=USART6_TX
PC7.GPIO_Label=ARDUINO RX/D0
PC7.Mode=Asynchronous
PC7.Signal=USART6_RX
PC8.Signal=SDMMC1_D0
PC9.Signal=SDMMC1_D1
PD0.GPIO_Label=FMC_D2 [MT48LC4M32B2B5-6A_DQ2]
PD0.Signal=FMC_D2_DA2
PD1.GPIO_Label=FMC_D3 [MT48LC4M32B2B5-6A_DQ3]
PD1.Signal=FMC_D3_DA3
PD10.GPIO_Label=FMC_D15 [MT48LC4M32B2B5-6A_DQ15]
PD10.Signal=FMC_D15_DA15
PD11.GPIO_Label=QSPI_D0 [N25Q128A13EF840E_DQ0]
PD11.Signal=QUADSPI_BK1_IO0
PD12.GPIO_Label=QSPI_D1 [N25Q128A13EF840E_DQ1]
PD12.Signal=QUADSPI_BK1_IO1
PD13.GPIO_Label=QSPI_D3 [N25Q128A13EF840E_DQ3]
PD13.Signal=QUADSPI_BK1_IO3
PD14.GPIO_Label=FMC_D0 [MT48LC4M32B2B5-6A_DQ0]
PD14.Signal=FMC_D0_DA0
PD15.GPIO_Label=FMC_D1 [MT48LC4M32B2B5-6A_DQ1]
PD15.Signal=FMC_D1_DA1
PD2.GPIO_Label=SDMMC_CMD
PD2.Signal=SDMMC1_CMD
PD3.GPIO_Label=LED16
PD3.Signal=GPIO_Output
PD4.GPIO_Label=OTG_FS_OverCurrent [STMPS2141STR_Fault]
PD4.Signal=GPIO_Input
PD5.GPIO_Label=OTG_FS_PowerSwitchOn [STMPS2141STR_EN]
PD5.PinState=GPIO_PIN_SET
PD5.Signal=GPIO_Output
PD6.GPIO_Label=Audio_INT
PD6.GPIO_ModeDefaultEXTI=GPIO_MODE_EVT_RISING
PD6.Signal=GPXTI6
PD7.GPIO_Label=SPDIF_RX0 [74LVC1G04SE_4]
PD7.Signal=SPDIFRX_IN0
PD8.GPIO_Label=FMC_D13 [MT48LC4M32B2B5-6A_DQ13]
PD8.Signal=FMC_D13_DA13
PD9.GPIO_Label=FMC_D14 [MT48LC4M32B2B5-6A_DQ14]
PD9.Signal=FMC_D14_DA14
PE0.GPIO_Label=FMC_NBL0 [MT48LC4M32B2B5-6A_DQM0]
PE0.Signal=FMC_NBL0
PE1.GPIO_Label=FMC_NBL1 [MT48LC4M32B2B5-6A_DQM1]
PE1.Signal=FMC_NBL1
PE10.GPIO_Label=FMC_D7 [MT48LC4M32B2B5-6A_DQ7]
PE10.Signal=FMC_D7_DA7
PE11.GPIO_Label=FMC_D8 [MT48LC4M32B2B5-6A_DQ8]
PE11.Signal=FMC_D8_DA8
PE12.GPIO_Label=FMC_D9 [MT48LC4M32B2B5-6A_DQ9]
PE12.Signal=FMC_D9_DA9
PE13.GPIO_Label=FMC_D10 [MT48LC4M32B2B5-6A_DQ10]
PE13.Signal=FMC_D10_DA10
PE14.GPIO_Label=FMC_D11 [MT48LC4M32B2B5-6A_DQ11]
PE14.Signal=FMC_D11_DA11
PE15.GPIO_Label=FMC_D12 [MT48LC4M32B2B5-6A_DQ12]
PE15.Signal=FMC_D12_DA12
PE2.GPIO_Label=QSPI_D2 [N25Q128A13EF840E_DQ2]
PE2.Signal=QUADSPI_BK1_IO2
PE3.GPIO_Label=OTG_HS_OverCurrent [STMPS2151STR_FAULT]
PE3.Signal=GPIO_Input
PE4.GPIO_Label=LCD_B0 [RK043FN48H-CT672B_B0]
PE4.Mode=RGB888
PE4.Signal=LTDC_B0
PE5.GPIO_Label=LED14
PE5.Signal=GPIO_Output
PE6.GPIO_Label=LED15
PE6.Signal=GPIO_Output
PE7.GPIO_Label=FMC_D4 [MT48LC4M32B2B5-6A_DQ4]
PE7.Signal=FMC_D4_DA4
PE8.GPIO_Label=FMC_D5 [MT48LC4M32B2B5-6A_DQ5]
PE8.Signal=FMC_D5_DA5
PE9.GPIO_Label=FMC_D6 [MT48LC4M32B2B5-6A_DQ6]
PE9.Signal=FMC_D6_DA6
PF0.GPIO_Label=FMC_A0 [MT48LC4M32B2B5-6A_A0]
PF0.Signal=FMC_A0
PF1.GPIO_Label=FMC_A1 [MT48LC4M32B2B5-6A_A1]
PF1.Signal=FMC_A1
PF10.Mode=IN8
PF10.Signal=ADC3_IN8
PF11.GPIO_Label=FMC_SDNRAS [MT48LC4M32B2B5-6A_RAS]
PF11.Signal=FMC_SDNRAS
PF12.GPIO_Label=FMC_A6 [MT48LC4M32B2B5-6A_A6]
PF12.Signal=FMC_A6
PF13.GPIO_Label=FMC_A7 [MT48LC4M32B2B5-6A_A7]
PF13.Signal=FMC_A7
PF14.GPIO_Label=FMC_A8 [MT48LC4M32B2B5-6A_A8]
PF14.Signal=FMC_A8
PF15.GPIO_Label=FMC_A9 [MT48LC4M32B2B5-6A_A9]
PF15.Signal=FMC_A9
PF2.GPIO_Label=FMC_A2 [MT48LC4M32B2B5-6A_A2]
PF2.Signal=FMC_A2
PF3.GPIO_Label=FMC_A3 [MT48LC4M32B2B5-6A_A3]
PF3.Signal=FMC_A3
PF4.GPIO_Label=FMC_A4 [MT48LC4M32B2B5-6A_A4]
PF4.Signal=FMC_A4
PF5.GPIO_Label=FMC_A5 [MT48LC4M32B2B5-6A_A5]
PF5.Signal=FMC_A5
PF6.Mode=Asynchronous
PF6.Signal=UART7_RX
PF7.Mode=Asynchronous
PF7.Signal=UART7_TX
PF8.GPIO_Label=ARDUINO A3
PF8.GPIO_Mode=GPIO_MODE_ANALOG
PF8.GPIO_PuPd=GPIO_NOPULL
PF8.Mode=IN6
PF8.Signal=ADC3_IN6
PF9.GPIO_Label=ARDUINO A2
PF9.GPIO_Mode=GPIO_MODE_ANALOG
PF9.GPIO_PuPd=GPIO_NOPULL
PF9.Mode=IN7
PF9.Signal=ADC3_IN7
PG0.GPIO_Label=FMC_A10 [MT48LC4M32B2B5-6A_A10]
PG0.Signal=FMC_A10
PG1.GPIO_Label=FMC_A11 [MT48LC4M32B2B5-6A_A11]
PG1.Signal=FMC_A11
PG10.GPIO_Label=SAI2_SDB [WM8994ECS/R_ADCDAT1]
PG10.Signal=SAI2_SD_B
PG11.GPIO_Label=RMII_TX_EN [LAN8742A-CZ-TR_TXEN]
PG11.Mode=RMII
PG11.Signal=ETH_TX_EN
PG12.GPIO_Label=LCD_B4 [RK043FN48H-CT672B_B4]
PG12.Mode=RGB888
PG12.Signal=LTDC_B4
PG13.GPIO_Label=RMII_TXD0 [LAN8742A-CZ-TR_TXD0]
PG13.Mode=RMII
PG13.Signal=ETH_TXD0
PG14.GPIO_Label=RMII_TXD1 [LAN8742A-CZ-TR_TXD1]
PG14.Mode=RMII
PG14.Signal=ETH_TXD1
PG15.GPIO_Label=FMC_SDNCAS [MT48LC4M32B2B5-6A_CAS]
PG15.Signal=FMC_SDNCAS
PG2.GPIO_Label=RMII_RXER
PG2.Signal=GPIO_Input
PG3.GPIO_Label=EXT_RST
PG3.Signal=GPIO_Output
PG4.GPIO_Label=FMC_BA0 [MT48LC4M32B2B5-6A_BA0]
PG4.Signal=FMC_A14_BA0
PG5.GPIO_Label=FMC_BA1 [MT48LC4M32B2B5-6A_BA1]
PG5.Signal=FMC_A15_BA1
PG6.GPIO_Label=ARDUINO D2
PG6.Signal=GPIO_Output
PG7.GPIO_Label=ARDUINO D4
PG7.Signal=GPIO_Output
PG8.GPIO_Label=FMC_SDCLK [MT48LC4M32B2B5-6A_CLK]
PG8.Signal=FMC_SDCLK
PG9.Signal=GPIO_Input
PH0/OSC_IN.GPIO_Label=OSC_25M [NZ2520SB-25.00M_OUT]
PH0/OSC_IN.Mode=HSE-External-Oscillator
PH0/OSC_IN.Signal=RCC_OSC_IN
PH1/OSC_OUT.Mode=HSE-External-Oscillator
PH1/OSC_OUT.Signal=RCC_OSC_OUT
PH10.GPIO_Label=LED18
PH10.Signal=GPIO_Output
PH11.GPIO_Label=LED12
PH11.Signal=GPIO_Output
PH12.GPIO_Label=LED17
PH12.Signal=GPIO_Output
PH13.Signal=GPIO_Input
PH14.GPIO_Label=LED13
PH14.Signal=GPIO_Output
PH15.GPIO_Label=TP3
PH15.Signal=GPIO_Input
PH2.GPIO_Label=NC2
PH2.Signal=GPIO_Input
PH3.GPIO_Label=FMC_SDNE0 [MT48LC4M32B2B5-6A_CS]
PH3.Mode=SdramChipSelect1_1
PH3.Signal=FMC_SDNE0
PH4.GPIO_Label=ULPI_NXT [USB3320C-EZK_NXT]
PH4.Mode=Host_HS
PH4.Signal=USB_OTG_HS_ULPI_NXT
PH5.GPIO_Label=FMC_SDNME [MT48LC4M32B2B5-6A_WE]
PH5.Signal=FMC_SDNWE
PH6.GPIO_Label=LED2
PH6.Signal=GPIO_Output
PH7.GPIO_Label=LCD_SCL [RK043FN48H-CT672B_SCL]
PH7.GPIO_Pu=GPIO_PULLUP
PH7.Mode=I2C
PH7.Signal=I2C3_SCL
PH8.GPIO_Label=LCD_SDA [RK043FN48H-CT672B_SDA]
PH8.GPIO_Pu=GPIO_PULLUP
PH8.Mode=I2C
PH8.Signal=I2C3_SDA
PH9.GPIO_Label=LED11
PH9.Signal=GPIO_Output
PI0.Mode=NSS_Signal_Hard_Output
PI0.Signal=SPI2_NSS
PI1.Mode=Full_Duplex_Master
PI1.Signal=SPI2_SCK
PI10.GPIO_Label=LCD_HSYNC [RK043FN48H-CT672B_HSYNC]
PI10.Mode=RGB888
PI10.Signal=LTDC_HSYNC
PI12.GPIO_Label=LCD_DISP [RK043FN48H-CT672B_DISP] 
PI12.PinState=GPIO_PIN_SET
PI12.Signal=GPIO_Output
PI13.GPIO_Label=LCD_INT
PI13.GPIO_ModeDefaultEXTI=GPIO_MODE_EVT_RISING
PI13.Signal=GPXTI13
PI14.GPIO_Label=LCD_CLK [RK043FN48H-CT672B_CLK]
PI14.Mode=RGB888
PI14.Signal=LTDC_CLK
PI15.GPIO_Label=LCD_R0 [RK043FN48H-CT672B_R0]
PI15.Mode=RGB888
PI15.Signal=LTDC_R0
PI2.Signal=S_TIM8_CH4
PI4.GPIO_Label=SAI2_MCLKA [WM8994ECS/R_MCLK1]
PI4.Signal=SAI2_MCLK_A
PI5.GPIO_Label=SAI2_SCKA [WM8994ECS/R_BCLK1]
PI5.Signal=SAI2_SCK_A
PI6.GPIO_Label=SAI2_SDA [WM8994ECS/R_DACDAT1]
PI6.Signal=SAI2_SD_A
PI7.GPIO_Label=SAI2_FSA [WM8994ECS/R_LRCLK1]
PI7.Signal=SAI2_FS_A
PI8.GPIO_Label=NC1 [TP2]
PI8.Mode=Timestamp enabled - Input Enabled to TS
PI8.Signal=RTC_TS
PI9.GPIO_Label=LCD_VSYNC [RK043FN48H-CT672B_VSYNC]
PI9.Mode=RGB888
PI9.Signal=LTDC_VSYNC
PJ0.GPIO_Label=LCD_R1 [RK043FN48H-CT672B_R1]
PJ0.Mode=RGB888
PJ0.Signal=LTDC_R1
PJ1.GPIO_Label=LCD_R2 [RK043FN48H-CT672B_R2]
PJ1.Mode=RGB888
PJ1.Signal=LTDC_R2
PJ10.GPIO_Label=LCD_G3 [RK043FN48H-CT672B_G3]
PJ10.Mode=RGB888
PJ10.Signal=LTDC_G3
PJ11.GPIO_Label=LCD_G4 [RK043FN48H-CT672B_G4]
PJ11.Mode=RGB888
PJ11.Signal=LTDC_G4
PJ12.GPIO_Label=OTG_FS_VBUS
PJ12.Signal=GPIO_Input
PJ13.GPIO_Label=LCD_B1 [RK043FN48H-CT672B_B1]
PJ13.Mode=RGB888
PJ13.Signal=LTDC_B1
PJ14.GPIO_Label=LCD_B2 [RK043FN48H-CT672B_B2]
PJ14.Mode=RGB888
PJ14.Signal=LTDC_B2
PJ15.GPIO_Label=LCD_B3 [RK043FN48H-CT672B_B3]
PJ15.Mode=RGB888
PJ15.Signal=LTDC_B3
PJ2.GPIO_Label=LCD_R3 [RK043FN48H-CT672B_R3]
PJ2.Mode=RGB888
PJ2.Signal=LTDC_R3
PJ3.GPIO_Label=LCD_R4 [RK043FN48H-CT672B_R4]
PJ3.Mode=RGB888
PJ3.Signal=LTDC_R4
PJ4.GPIO_Label=LCD_R5 [RK043FN48H-CT672B_R5]
PJ4.Mode=RGB888
PJ4.Signal=LTDC_R5
PJ5.GPIO_Label=LCD_R6 [RK043FN48H-CT672B_R6]
PJ5.Mode=RGB888
PJ5.Signal=LTDC_R6
PJ6.GPIO_Label=LCD_R7 [RK043FN48H-CT672B_R7]
PJ6.Mode=RGB888
PJ6.Signal=LTDC_R7
PJ7.GPIO_Label=LCD_G0 [RK043FN48H-CT672B_G0]
PJ7.Mode=RGB888
PJ7.Signal=LTDC_G0
PJ8.GPIO_Label=LCD_G1 [RK043FN48H-CT672B_G1]
PJ8.Mode=RGB888
PJ8.Signal=LTDC_G1
PJ9.GPIO_Label=LCD_G2 [RK043FN48H-CT672B_G2]
PJ9.Mode=RGB888
PJ9.Signal=LTDC_G2
PK0.GPIO_Label=LCD_G5 [RK043FN48H-CT672B_G5]
PK0.Mode=RGB888
PK0.Signal=LTDC_G5
PK1.GPIO_Label=LCD_G6 [RK043FN48H-CT672B_G6]
PK1.Mode=RGB888
PK1.Signal=LTDC_G6
PK2.GPIO_Label=LCD_G7 [RK043FN48H-CT672B_G7]
PK2.Mode=RGB888
PK2.Signal=LTDC_G7
PK3.GPIO_Label=LCD_BL_CTRL [STLD40DPUR_EN]
PK3.GPIO_Speed=GPIO_SPEED_FREQ_LOW
PK3.PinState=GPIO_PIN_SET
PK3.Signal=GPIO_Output
PK4.GPIO_Label=LCD_B5 [RK043FN48H-CT672B_B5]
PK4.Mode=RGB888
PK4.Signal=LTDC_B5
PK5.GPIO_Label=LCD_B6 [RK043FN48H-CT672B_B6]
PK5.Mode=RGB888
PK5.Signal=LTDC_B6
PK6.GPIO_Label=LCD_B7 [RK043FN48H-CT672B_B7]
PK6.Mode=RGB888
PK6.Signal=LTDC_B7
PK7.GPIO_Label=LCD_DE [RK043FN48H-CT672B_DE]
PK7.Mode=RGB888
PK7.Signal=LTDC_DE
ProjectManager.HeapSize=0x200
ProjectManager.StackSize=0x400
ProjectManager.TargetToolchain=STM32CubeIDE
RCC.AHBFreq_Value=200000000
RCC.APB1CLKDivider=RCC_HCLK_DIV4
RCC.APB1Freq_Value=50000000
RCC.APB1TimFreq_Value=100000000
RCC.APB2CLKDivider=RCC_HCLK_DIV2
RCC.APB2Freq_Value=100000000
RCC.APB2TimFreq_Value=200000000
RCC.CortexFreq_Value=200000000
RCC.HCLKFreq_Value=200000000
RCC.HSE_VALUE=25000000
RCC.HSI_VALUE=16000000
RCC.PLL48CLockSelection=RCC_CLK48SOURCE_PLLSAIP
RCC.PLLI2SN=100
RCC.PLLM=25
RCC.PLLN=400
RCC.PLLQ=9
RCC.PLLSAIN=384
RCC.PLLSAIP=RCC_PLLSAIP_DIV8
RCC.PLLSAIR=5
RCC.PLLSAIRDiv=RCC_PLLSAIDIVR_8
RCC.PLLSourceVirtual=RCC_PLLSOURCE_HSE
RCC.SDMMCClockSelection=RCC_SDMMC1CLKSOURCE_CLK48
RCC.SYSCLKFreq_VALUE=200000000
RCC.SYSCLKSource=RCC_SYSCLKSOURCE_PLLCLK
RCC.USBFreq_Value=48000000
RCC.VCOOutputFreq_Value=400000000
RTC.Alarm-Alarm\ A=RTC_ALARM_A
RTC.Alarm_B-Alarm\ B=RTC_ALARM_B
SH.ADCx_IN0.0=ADC1_IN0,IN0
SH.COMP_DAC1_group.0=DAC_OUT1,DAC_OUT1
SH.FMC_A0.0=FMC_A0,12b-sda1
SH.FMC_A1.0=FMC_A1,12b-sda1
SH.FMC_A10.0=FMC_A10,12b-sda1
SH.FMC_A11.0=FMC_A11,12b-sda1
SH.FMC_A14_BA0.0=FMC_BA0,FourSdramBanks1
SH.FMC_A15_BA1.0=FMC_BA1,FourSdramBanks1
SH.FMC_A2.0=FMC_A2,12b-sda1
SH.FMC_A3.0=FMC_A3,12b-sda1
SH.FMC_A4.0=FMC_A4,12b-sda1
SH.FMC_A5.0=FMC_A5,12b-sda1
SH.FMC_A6.0=FMC_A6,12b-sda1
SH.FMC_A7.0=FMC_A7,12b-sda1
SH.FMC_A8.0=FMC_A8,12b-sda1
SH.FMC_A9.0=FMC_A9,12b-sda1
SH.FMC_D0_DA0.0=FMC_D0,sd-16b-d1
SH.FMC_D10_DA10.0=FMC_D10,sd-16b-d1
SH.FMC_D11_DA11.0=FMC_D11,sd-16b-d1
SH.FMC_D12_DA12.0=FMC_D12,sd-16b-d1
SH.FMC_D13_DA13.0=FMC_D13,sd-16b-d1
SH.FMC_D14_DA14.0=FMC_D14,sd-16b-d1
SH.FMC_D15_DA15.0=FMC_D15,sd-16b-d1
SH.FMC_D1_DA1.0=FMC_D1,sd-16b-d1
SH.FMC_D2_DA2.0=FMC_D2,sd-16b-d1
SH.FMC_D3_DA3.0=FMC_D3,sd-16b-d1
SH.FMC_D4_DA4.0=FMC_D4,sd-16b-d1
SH.FMC_D5_DA5.0=FMC_D5,sd-16b-d1
SH.FMC_D6_DA6.0=FMC_D6,sd-16b-d1
SH.FMC_D7_DA7.0=FMC_D7,sd-16b-d1
SH.FMC_D8_DA8.0=FMC_D8,sd-16b-d1
SH.FMC_D9_DA9.0=FMC_D9,sd-16b-d1
SH.FMC_NBL0.0=FMC_NBL0,Sd2ByteEnable1
SH.FMC_NBL1.0=FMC_NBL1,Sd2ByteEnable1
SH.FMC_SDCLK.0=FMC_SDCLK,12b-sda1
SH.FMC_SDNCAS.0=FMC_SDNCAS,12b-sda1
SH.FMC_SDNRAS.0=FMC_SDNRAS,12b-sda1
SH.FMC_SDNWE.0=FMC_SDNWE,12b-sda1
SH.S_TIM8_CH4.0=TIM8_CH4
SPI2.CalculateBaudRate=25.0 MBits/s
SPI2.Direction=SPI_DIRECTION_2LINES
SPI2.Mode=SPI_MODE_MASTER
SPI2.VirtualNSS=VM_NSSHARD
SPI2.VirtualType=VM_MASTER
TIM5.Channel-PWM\ Generation4\ CH4=TIM_CHANNEL_4
USART1.OverrunDisableParam=ADVFEATURE_OVERRUN_DISABLE
USART1.VirtualMode-Asynchronous=VM_ASYNC
USART6.VirtualMode-Asynchronous=VM_ASYNC
VP_DMA2D_VS_DMA2D.Mode=DMA2D_Activate
VP_FREERTOS_VS_CMSIS_V1.Mode=CMSIS_V1
VP_LWIP_VS_Enabled.Mode=Enabled
VP_RTC_VS_RTC_Activate.Mode=RTC_Enabled
VP_RTC_VS_RTC_Alarm_A_Intern.Mode=Alarm A
VP_RTC_VS_RTC_Alarm_B_Intern.Mode=Alarm B
VP_RTC_VS_RTC_Calendar.Mode=RTC_Calendar
VP_SYS_VS_tim6.Mode=TIM6
VP_TIM1_VS_ClockSourceINT.Mode=Internal
VP_TIM2_VS_ClockSourceINT.Mode=Internal
VP_TIM3_VS_ClockSourceINT.Mode=Internal
VP_TIM5_VS_ClockSourceINT.Mode=Internal
VP_TIM8_VS_ClockSourceINT.Mode=Internal
board=STM32F746G-DISCO

// file: main.c
/* USER CODE BEGIN Header */
/**
  ******************************************************************************
  * @file           : main.c
  * @brief          : Main program body
  ******************************************************************************
  * @attention
  *
  * Copyright (c) 2022 STMicroelectronics.
  * All rights reserved.
  *
  * This software is licensed under terms that can be found in the LICENSE file
  * in the root directory of this software component.
  * If no LICENSE file comes with this software, it is provided AS-IS.
  *
  ******************************************************************************
  */
/* USER CODE END Header */
#include "main.h"
#include "cmsis_os.h"
#include "adc.h"
#include "dac.h"
#include "dma2d.h"
#include "i2c.h"
#include "ltdc.h"
#include "lwip.h"
#include "rtc.h"
#include "spi.h"
#include "tim.h"
#include "usart.h"
#include "gpio.h"
#include "fmc.h"

/* USER CODE BEGIN Includes */
#include "stm32746g_discovery_lcd.h"
#include "stm32746g_discovery_ts.h"
#include "stdio.h"

#include "HorombeRGB565.h"
#include "Scorvol.h"
/* USER CODE END Includes */

/* USER CODE BEGIN PV */
uint32_t joystick_v;
/* USER CODE END PV */

void SystemClock_Config(void);
void MX_FREERTOS_Init(void);

/* USER CODE BEGIN 0 */

typedef enum {
	bleu,
	rouge,
	noir,
	jaune
}ColorState;

/* USER CODE END 0 */

int main(void)
{

  /* USER CODE BEGIN 1 */
	char text[60]={};
	static TS_StateTypeDef  TS_State;
	uint32_t potl,potr,joystick_h;
	ADC_ChannelConfTypeDef sConfig = {0};
	sConfig.Rank = ADC_REGULAR_RANK_1;
	sConfig.SamplingTime = ADC_SAMPLETIME_3CYCLES;

	RTC_TimeTypeDef sTime = {0};
	RTC_DateTypeDef sDate = {0};

	uint32_t pos_x = 200;
	uint32_t pos_y = 130;
	uint32_t pos_x_old = 200;
	uint32_t pos_y_old = 130;

	uint8_t carac;
	char  aie[] = "ouch\n\r";
	char ouch[] = "aiee\n\r";
	uint8_t bobo = 0;

	GPIO_PinState bp1=GPIO_PIN_RESET;
	GPIO_PinState bp2=GPIO_PIN_RESET;

  /* USER CODE END 1 */

  /* MCU Configuration--------------------------------------------------------*/

  /* Reset of all peripherals, Initializes the Flash interface and the Systick. */
  HAL_Init();

  /* Configure the system clock */
  SystemClock_Config();

  /* Initialize all configured peripherals */
  MX_GPIO_Init();
  MX_ADC3_Init();
  MX_DMA2D_Init();
  MX_FMC_Init();
  MX_I2C1_Init();
  MX_I2C3_Init();
  MX_LTDC_Init();
  MX_RTC_Init();
  MX_SPI2_Init();
  MX_TIM1_Init();
  MX_TIM2_Init();
  MX_TIM3_Init();
  MX_TIM5_Init();
  MX_TIM8_Init();
  MX_USART1_UART_Init();
  MX_USART6_UART_Init();
  MX_ADC1_Init();
  MX_DAC_Init();
  MX_UART7_Init();
  /* USER CODE BEGIN 2 */
  BSP_LCD_Init();
  BSP_LCD_LayerDefaultInit(0, LCD_FB_START_ADDRESS);
  BSP_LCD_LayerDefaultInit(1, LCD_FB_START_ADDRESS+ BSP_LCD_GetXSize()*BSP_LCD_GetYSize()*4);
  BSP_LCD_DisplayOn();
  BSP_LCD_SelectLayer(0);
//  BSP_LCD_Clear(LCD_COLOR_RED);
//  BSP_LCD_DrawBitmap(0,0,(uint8_t*)HorombeRGB565_bmp);
//  BSP_LCD_SelectLayer(1);
  BSP_LCD_Clear(LCD_COLOR_WHITE);
  BSP_LCD_SetFont(&Font12);
  BSP_LCD_SetTextColor(LCD_COLOR_BLUE);

  BSP_LCD_SelectLayer(1);
  BSP_LCD_Clear(LCD_COLOR_BLACK);
  BSP_LCD_SetFont(&Font12);
  BSP_LCD_SetTextColor(LCD_COLOR_BLUE);
  // carré qui se déplace

  BSP_TS_Init(BSP_LCD_GetXSize(), BSP_LCD_GetYSize());

  HAL_TIM_Base_Start_IT(&htim3);
  /* USER CODE END 2 */

  /* Call init function for freertos objects (in cmsis_os2.c) */
  MX_FREERTOS_Init();

  /* Start scheduler */
  osKernelStart();

  /* We should never get here as control is now taken by the scheduler */

  /* Infinite loop */
  /* USER CODE BEGIN WHILE */
  while (1)
  {
	  	// actualise l'affichage
	  	BSP_LCD_SelectLayer(1);
	  	if ((pos_x_old!=pos_x)||(pos_y_old!=pos_y)){
	  		BSP_LCD_Clear(00);
	  		pos_x_old = pos_x;
	  		pos_y_old = pos_y;
	  	}

		BSP_LCD_FillRect((uint16_t) pos_x, (uint16_t) pos_y, 8, 8);

		// machine a etatsn
		bp1 = HAL_GPIO_ReadPin(BP1_GPIO_Port,BP1_Pin);
		bp2 = HAL_GPIO_ReadPin(BP2_GPIO_Port,BP2_Pin);

		if ((bp1 == GPIO_PIN_SET)&&(bp2 == GPIO_PIN_SET)){
			BSP_LCD_SetTextColor(LCD_COLOR_RED);
		}
		if((bp1 == GPIO_PIN_SET)&&(bp2 == GPIO_PIN_RESET)){
			BSP_LCD_SetTextColor(LCD_COLOR_BLUE);
		}
		if((bp1 == GPIO_PIN_RESET)&&(bp2 == GPIO_PIN_SET)){
			BSP_LCD_SetTextColor(LCD_COLOR_BLACK);
		}
		if((bp1 == GPIO_PIN_RESET)&&(bp2 == GPIO_PIN_RESET)){
			BSP_LCD_SetTextColor(LCD_COLOR_YELLOW);
		}

		BSP_LCD_SelectLayer(0);

	  	HAL_GPIO_WritePin(LED13_GPIO_Port,LED13_Pin,HAL_GPIO_ReadPin(BP1_GPIO_Port,BP1_Pin));
		HAL_GPIO_WritePin(LED14_GPIO_Port,LED14_Pin,HAL_GPIO_ReadPin(BP2_GPIO_Port,BP2_Pin));
		sprintf(text,"BP1 : %d",HAL_GPIO_ReadPin(BP1_GPIO_Port,BP1_Pin));
		BSP_LCD_DisplayStringAtLine(5,(uint8_t*) text);

		sConfig.Channel = ADC_CHANNEL_6;
		HAL_ADC_ConfigChannel(&hadc3, &sConfig);
		HAL_ADC_Start(&hadc3);
		while(HAL_ADC_PollForConversion(&hadc3, 100)!=HAL_OK);
		potr = HAL_ADC_GetValue(&hadc3);
		// display potr value
		sprintf(text,"potr value : %ld",potr);
		BSP_LCD_DisplayStringAtLine(6,(uint8_t*) text);
		// change LED blinking speed using potr
		htim3.Instance->ARR = 10000 - potr;

		sConfig.Channel = ADC_CHANNEL_7;
		HAL_ADC_ConfigChannel(&hadc3, &sConfig);
		HAL_ADC_Start(&hadc3);
		while(HAL_ADC_PollForConversion(&hadc3, 100)!=HAL_OK);
		potl = HAL_ADC_GetValue(&hadc3);

		htim3.Instance->PSC = 5000 - potl;

		sConfig.Channel = ADC_CHANNEL_8;
		HAL_ADC_ConfigChannel(&hadc3, &sConfig);
		HAL_ADC_Start(&hadc3);
		while(HAL_ADC_PollForConversion(&hadc3, 100)!=HAL_OK);
		joystick_v = HAL_ADC_GetValue(&hadc3);

		HAL_ADC_Start(&hadc1);
		while(HAL_ADC_PollForConversion(&hadc1, 100)!=HAL_OK);
		joystick_h = HAL_ADC_GetValue(&hadc1);

		sprintf(text,"POTL : %4u POTR : %4u joy_v : %4u joy_h : %4u \n\r",(uint16_t)potl,(uint16_t)potr,(uint16_t)joystick_v,(uint16_t)joystick_h);
		BSP_LCD_DisplayStringAtLine(9,(uint8_t*) text);

		// UART Display of joysticks
//		HAL_UART_Transmit(&huart1,(uint8_t*) text, 60, 100);
//		HAL_UART_Receive(&huart1,receive, 60, 10000);
//		BSP_LCD_DisplayStringAtLine(10,(uint8_t*) receive);

		HAL_UART_Receive(&huart1,&carac, 1, 1);
		if (carac == 'a'){
			HAL_GPIO_WritePin(LED2_GPIO_Port,LED2_Pin,1);
		}
		if (carac == 'e'){
			HAL_GPIO_WritePin(LED2_GPIO_Port,LED2_Pin,0);
		}

		if ((joystick_v > 3500)&&(pos_y>2)){
			pos_y -= 2;
		}
		if ((joystick_v < 1500)&&(pos_y<270)){
			pos_y += 2;
		}
		if ((joystick_h > 3500)&&(pos_x>2)){
			pos_x -= 2;
		}
		if ((joystick_h < 1500)&&(pos_x<478)){
			pos_x += 2;
		}

		// horloge temps réel
		HAL_RTC_GetTime(&hrtc, &sTime, RTC_FORMAT_BIN);
		sprintf(text,"Date : %4u h: %4u mn : %4u sec", (uint8_t) sTime.Hours,(uint8_t) sTime.Minutes, (uint8_t) sTime.Seconds);
		BSP_LCD_DisplayStringAtLine(10,(uint8_t*) text);
		HAL_RTC_GetDate(&hrtc, &sDate, RTC_FORMAT_BIN);

		BSP_TS_GetState(&TS_State);
		if(TS_State.touchDetected){
			//TODO : Il faudrait vérifier que le cercle reste entièrement sur l'écran...
		  BSP_LCD_FillCircle(TS_State.touchX[0],TS_State.touchY[0],4);
		  switch (bobo){
		  case 1:
			  HAL_UART_Transmit(&huart1,(uint8_t*) aie, 8, 1);
			  bobo = 0;
		  case 0:
			  HAL_UART_Transmit(&huart1,(uint8_t*) ouch, 8, 1);
			  bobo = 1;
		  }

	  	  }

    /* USER CODE END WHILE */

  }
}

void SystemClock_Config(void)
{
  RCC_OscInitTypeDef RCC_OscInitStruct = {0};
  RCC_ClkInitTypeDef RCC_ClkInitStruct = {0};

  /** Configure LSE Drive Capability
  */
  HAL_PWR_EnableBkUpAccess();

  /** Configure the main internal regulator output voltage
  */
  __HAL_RCC_PWR_CLK_ENABLE();
  __HAL_PWR_VOLTAGESCALING_CONFIG(PWR_REGULATOR_VOLTAGE_SCALE1);

  /** Initializes the RCC Oscillators according to the specified parameters
  * in the RCC_OscInitTypeDef structure.
  */
  RCC_OscInitStruct.OscillatorType = RCC_OSCILLATORTYPE_LSI|RCC_OSCILLATORTYPE_HSE;
  RCC_OscInitStruct.HSEState = RCC_HSE_ON;
  RCC_OscInitStruct.LSIState = RCC_LSI_ON;
  RCC_OscInitStruct.PLL.PLLState = RCC_PLL_ON;
  RCC_OscInitStruct.PLL.PLLSource = RCC_PLLSOURCE_HSE;
  RCC_OscInitStruct.PLL.PLLM = 25;
  RCC_OscInitStruct.PLL.PLLN = 400;
  RCC_OscInitStruct.PLL.PLLP = RCC_PLLP_DIV2;
  RCC_OscInitStruct.PLL.PLLQ = 9;
  if (HAL_RCC_OscConfig(&RCC_OscInitStruct) != HAL_OK)
  {
    Error_Handler();
  }

  /** Activate the Over-Drive mode
  */
  if (HAL_PWREx_EnableOverDrive() != HAL_OK)
  {
    Error_Handler();
  }

  /** Initializes the CPU, AHB and APB buses clocks
  */
  RCC_ClkInitStruct.ClockType = RCC_CLOCKTYPE_HCLK|RCC_CLOCKTYPE_SYSCLK
                              |RCC_CLOCKTYPE_PCLK1|RCC_CLOCKTYPE_PCLK2;
  RCC_ClkInitStruct.SYSCLKSource = RCC_SYSCLKSOURCE_PLLCLK;
  RCC_ClkInitStruct.AHBCLKDivider = RCC_SYSCLK_DIV1;
  RCC_ClkInitStruct.APB1CLKDivider = RCC_HCLK_DIV4;
  RCC_ClkInitStruct.APB2CLKDivider = RCC_HCLK_DIV2;

  if (HAL_RCC_ClockConfig(&RCC_ClkInitStruct, FLASH_LATENCY_6) != HAL_OK)
  {
    Error_Handler();
  }
}

void HAL_TIM_PeriodElapsedCallback(TIM_HandleTypeDef *htim)
{
  /* USER CODE BEGIN Callback 0 */
	if (htim->Instance == TIM3){
		// toggle LED
		HAL_GPIO_TogglePin(LED11_GPIO_Port, LED11_Pin);
	}

  /* USER CODE END Callback 0 */
  if (htim->Instance == TIM6) {
    HAL_IncTick();
  }
}

void Error_Handler(void)
{
  __disable_irq();
  while (1)
  {
  }
}

// file: freertos.c
/* USER CODE BEGIN Header */
/**
 ******************************************************************************
 * File Name          : freertos.c
 * Description        : Code for freertos applications
 ******************************************************************************
 * @attention
 *
 * Copyright (c) 2025 STMicroelectronics.
 * All rights reserved.
 *
 * This software is licensed under terms that can be found in the LICENSE file
 * in the root directory of this software component.
 * If no LICENSE file comes with this software, it is provided AS-IS.
 *
 ******************************************************************************
 */
/* USER CODE END Header */

#include "FreeRTOS.h"
#include "task.h"
#include "main.h"
#include "cmsis_os.h"

/* USER CODE BEGIN Includes */
#include "stm32746g_discovery_lcd.h"
#include "stm32746g_discovery_ts.h"
#include "stdio.h"
#include "string.h"
#include "lwip.h"
#include "gpio.h"
#include "lwip/netif.h"
#include "lwip/netbuf.h"
#include "lwip/api.h"

#include "adc.h"
#include "dac.h"

#include "hadouken.h"
#include "normal.h"
#include "jaby.h"
#include "Flamme.h"

#include "hadouken2.h"
#include "normal2.h"
#include "jaby2.h"
#include "Flamme2.h"
/* USER CODE END Includes */

/* USER CODE BEGIN PD */
#define TCP_SERVER_PORT 8080
#define Dim_v 268
#define Dim_h 478
#define SPRITE_WIDTH 40
#define PORTEE_COUP 80  // distance max entre joueurs pour qu’un coup touche
#define DEGATS_COUP 10  // points de vie en moins
#define VIE_MAX 100
#define ENVOI 1
#define RECEPTION 2
/* USER CODE END PD */

/* USER CODE BEGIN Variables */
char text[30] = {};
char other[50] = {};
char self[] = "Client to server";
extern struct netif gnetif;

char buf[30];

uint8_t jeu_termine = 0;
uint8_t attente_relachement_BP = 0;
uint8_t j1_KO = 0;
uint8_t j2_KO = 0;

uint8_t vie_j1 = VIE_MAX;
int coup_j1_duree = 0;

int vie_j2 = VIE_MAX;
int coup_j2_duree = 0;
uint8_t etat_j2 = 0;  // 0 normal, 1 attaque

static int pos_x_j1= Dim_h/8;
int pos_y_j1;
int pos_x_j2 =Dim_h - Dim_h/8;
int pos_y_j2;
uint16_t vitesse =300;
uint8_t etat_j1 =0; //0 normal , 1 : jab , 2 hadouken

int flamme_x_j1 = -1; // -1 = inactive
int flamme_x_j2 = -1;

int pos_y_j1 = 0;  // 0 = sol, > 0 = en l’air
uint8_t saut_j1_en_cours = 0;
int saut_j1_duree = 0;

int pos_y_j2 = 0;  // 0 = sol, > 0 = en l’air
uint8_t saut_j2_en_cours = 0;
int saut_j2_duree = 0;

typedef struct {
	uint8_t joueur;
	uint8_t jeu_termine;
	uint8_t attente_relachement_BP;
	uint8_t vie_j1;
	int pos_x_j1;
	int pos_y_j1;
	uint8_t etat_j1; //0 normal , 1 : jab , 2 hadouken
}envoi_t;
envoi_t envoi;

typedef struct {
	uint8_t joueur;
	uint8_t jeu_termine;
	uint8_t attente_relachement_BP;
	uint8_t vie_j2;
	int pos_x_j2;
	int pos_y_j2;
	uint8_t etat_j2; //0 normal , 1 : jab , 2 hadouken
}reception_t;

reception_t reception;

/* USER CODE END Variables */
osThreadId defaultTaskHandle;
osThreadId tache_joueur_1Handle;
osThreadId tache_affichageHandle;
osSemaphoreId tcpsemHandle;

/* USER CODE BEGIN FunctionPrototypes */
void copy_state(int envoi_reception);
/* USER CODE END FunctionPrototypes */

void StartDefaultTask(void const * argument);
void Fonction_tache_joueur_1(void const * argument);
void Fonction_tache_affichage(void const * argument);

extern void MX_LWIP_Init(void);
void MX_FREERTOS_Init(void); /* (MISRA C 2004 rule 8.1) */

/* GetIdleTaskMemory prototype (linked to static allocation support) */
void vApplicationGetIdleTaskMemory( StaticTask_t **ppxIdleTaskTCBBuffer, StackType_t **ppxIdleTaskStackBuffer, uint32_t *pulIdleTaskStackSize );

/* USER CODE BEGIN GET_IDLE_TASK_MEMORY */
static StaticTask_t xIdleTaskTCBBuffer;
static StackType_t xIdleStack[configMINIMAL_STACK_SIZE];

void vApplicationGetIdleTaskMemory( StaticTask_t **ppxIdleTaskTCBBuffer, StackType_t **ppxIdleTaskStackBuffer, uint32_t *pulIdleTaskStackSize )
{
	*ppxIdleTaskTCBBuffer = &xIdleTaskTCBBuffer;
	*ppxIdleTaskStackBuffer = &xIdleStack[0];
	*pulIdleTaskStackSize = configMINIMAL_STACK_SIZE;
	/* place for user code */
}
/* USER CODE END GET_IDLE_TASK_MEMORY */

void MX_FREERTOS_Init(void) {

	/* Create the semaphores(s) */
	/* definition and creation of tcpsem */
	osSemaphoreDef(tcpsem);
	tcpsemHandle = osSemaphoreCreate(osSemaphore(tcpsem), 1);

	/* Create the thread(s) */
	/* definition and creation of defaultTask */
	osThreadDef(defaultTask, StartDefaultTask, osPriorityNormal, 0, 256);
	defaultTaskHandle = osThreadCreate(osThread(defaultTask), NULL);

	/* definition and creation of tache_joueur_1 */
	osThreadDef(tache_joueur_1, Fonction_tache_joueur_1, osPriorityNormal, 0, 256);
	tache_joueur_1Handle = osThreadCreate(osThread(tache_joueur_1), NULL);

	/* definition and creation of tache_affichage */
	osThreadDef(tache_affichage, Fonction_tache_affichage, osPriorityNormal, 0, 1024);
	tache_affichageHandle = osThreadCreate(osThread(tache_affichage), NULL);

}

void StartDefaultTask(void const * argument)
{
	/* init code for LWIP */
	MX_LWIP_Init();
	/* USER CODE BEGIN StartDefaultTask */
	while (ip4_addr_isany_val(*netif_ip4_addr(&gnetif))) {
		osDelay(200);
	}

	sprintf(text,"READY, IP: %s\n", (char*)ip4addr_ntoa(netif_ip4_addr(&gnetif)));
	BSP_LCD_DisplayStringAtLine(1, (uint8_t *) text);

	struct netconn *conn;
	struct netbuf *buf;
	void *data;
	u16_t len;
	err_t err;
	ip_addr_t server_ip;

	IP4_ADDR(&server_ip, 192,168,0,168);

	conn = netconn_new(NETCONN_TCP);

	if (netconn_connect(conn, &server_ip, 5000) != ERR_OK) {
		netconn_delete(conn);
		vTaskDelete(NULL);
	}

	while (1) {
		// Envoi état client
		copy_state(ENVOI);
		err = netconn_write(conn, &envoi, sizeof(envoi), NETCONN_COPY);
		if (err != ERR_OK) break;

		// Réception état serveur
		if (netconn_recv(conn, &buf) == ERR_OK) {
			netbuf_data(buf, &data, &len);
			if (len > 0) {
				memcpy(&reception, data, sizeof(reception));
				copy_state(RECEPTION);
			}
			netbuf_delete(buf);
		} else {
			break;
		}

		osDelay(50);
	}
	netconn_close(conn);
	netconn_delete(conn);
	vTaskDelete(NULL);
	/* USER CODE END StartDefaultTask */
}

void Fonction_tache_joueur_1(void const * argument)
{
	/* USER CODE BEGIN Fonction_tache_joueur_1 */

	uint32_t joystick_h=2000;
	uint32_t  joystick_v;
	static TS_StateTypeDef  TS_State;
	ADC_ChannelConfTypeDef sConfig = {0};
	sConfig.Rank = ADC_REGULAR_RANK_1;
	sConfig.SamplingTime = ADC_SAMPLETIME_3CYCLES;

	uint8_t BP1 = HAL_GPIO_ReadPin(BP1_GPIO_Port, BP1_Pin);
	static uint8_t BP1_old = GPIO_PIN_SET;

	uint8_t BP2 = HAL_GPIO_ReadPin(BP2_GPIO_Port, BP2_Pin);
	static uint8_t BP2_old = GPIO_PIN_SET;
	/* Infinite loop */
	for(;;)
	{

		sConfig.Channel = ADC_CHANNEL_6;
		HAL_ADC_ConfigChannel(&hadc3, &sConfig);
		HAL_ADC_Start(&hadc3);
		while(HAL_ADC_PollForConversion(&hadc3, 100)!=HAL_OK);
		//potr = HAL_ADC_GetValue(&hadc3);

		sConfig.Channel = ADC_CHANNEL_7;
		HAL_ADC_ConfigChannel(&hadc3, &sConfig);
		HAL_ADC_Start(&hadc3);
		while(HAL_ADC_PollForConversion(&hadc3, 100)!=HAL_OK);
		//potl = HAL_ADC_GetValue(&hadc3);

		sConfig.Channel = ADC_CHANNEL_8;
		HAL_ADC_ConfigChannel(&hadc3, &sConfig);
		HAL_ADC_Start(&hadc3);
		while(HAL_ADC_PollForConversion(&hadc3, 100)!=HAL_OK);
		joystick_v = HAL_ADC_GetValue(&hadc3);

		HAL_ADC_Start(&hadc1);
		while(HAL_ADC_PollForConversion(&hadc1, 100)!=HAL_OK);
		joystick_h = HAL_ADC_GetValue(&hadc1);

		if (joystick_h > 2200 && pos_x_j1 > 0) {
			pos_x_j1--;
		}
		if (joystick_h < 1900 && pos_x_j1 < Dim_h) {
			if (pos_x_j1 + SPRITE_WIDTH < pos_x_j2) {
				pos_x_j1++;
			}
		}

		// Saut : joystick vers le haut
		if (joystick_v  > 2100 && !saut_j1_en_cours && !jeu_termine) {
			saut_j1_en_cours = 1;
			saut_j1_duree = 40;
		}
		// Gestion du saut
		if (saut_j1_en_cours) {
			if (saut_j1_duree > 10) {
				pos_y_j1 = 50;  // hauteur max (monte)
			} else {
				pos_y_j1 = 0;   // retombe au sol
			}
			saut_j1_duree--;
			if (saut_j1_duree == 0) {
				saut_j1_en_cours = 0;
				pos_y_j1 = 0;
				saut_j1_duree = 0;
			}
		}

		//JAB
		BP1 = HAL_GPIO_ReadPin(BP1_GPIO_Port, BP1_Pin);
		if (BP1 == GPIO_PIN_RESET && BP1_old == GPIO_PIN_SET) {
			etat_j1=1;
			coup_j1_duree = 10;
		}
		BP1_old = BP1;

		//Hadouken
		BP2 = HAL_GPIO_ReadPin(BP2_GPIO_Port, BP2_Pin);
		if (BP2 == GPIO_PIN_RESET && BP2_old == GPIO_PIN_SET) {
			etat_j1 = 2;
			coup_j1_duree = 35;
		}

		BP2_old = BP2;

		//RESET JEU APRES KO

		if (jeu_termine) {
			// Attente relâchement
			if (!attente_relachement_BP) {
				if (BP1 == GPIO_PIN_SET) {
					attente_relachement_BP = 1; // le joueur a relâché
				}
			} else {
				if (BP1 == GPIO_PIN_RESET) {
					// RESET DU JEU
					vie_j1 = VIE_MAX;
					vie_j2 = VIE_MAX;
					j1_KO = 0;
					j2_KO = 0;
					etat_j1 = 0;
					etat_j2 = 0;
					coup_j1_duree = 0;
					coup_j2_duree = 0;
					pos_x_j1 = Dim_h / 8;
					pos_x_j2 = Dim_h - Dim_h / 8;
					jeu_termine = 0;
					attente_relachement_BP = 0;
				}
			}
			// On saute le reste de la logique tant que le jeu est terminé
			vTaskDelay(10);
			continue;
		}

		vTaskDelay(10);
	}
	/* USER CODE END Fonction_tache_joueur_1 */
}

void Fonction_tache_affichage(void const * argument)
{
	/* USER CODE BEGIN Fonction_tache_affichage */
	/* Infinite loop */
	for(;;)
	{

		if (jeu_termine==1) {
			// Écran rouge
			BSP_LCD_Clear(LCD_COLOR_RED);
			BSP_LCD_SetTextColor(LCD_COLOR_BLACK);
			BSP_LCD_SetBackColor(LCD_COLOR_RED);
			BSP_LCD_SetFont(&Font24);
			if (j1_KO) {
				BSP_LCD_DisplayStringAt(0, BSP_LCD_GetYSize()/2 - 30, (uint8_t*)"JOUEUR 1 KO !", CENTER_MODE);
			} else if (j2_KO) {
				BSP_LCD_DisplayStringAt(0, BSP_LCD_GetYSize()/2 - 30, (uint8_t*)"JOUEUR 2 KO !", CENTER_MODE);
			}
			BSP_LCD_SetFont(&Font16);
			BSP_LCD_DisplayStringAt(0, BSP_LCD_GetYSize()/2 + 20, (uint8_t*)"Appuyez sur un bouton pour rejouer", CENTER_MODE);

			// Attente du bouton (dans tache joueur 1 ou 2, ici on met juste pause)
			vTaskDelay(100);
			continue;
		}

		//Si le jeu est en cours de route
		if (jeu_termine==0){
			BSP_LCD_SelectLayer(1);
			BSP_LCD_Clear(00);

			int barre_largeur = (Dim_h / 3); // Largeur totale de la barre
			int hauteur = 10;
			int x = 10;
			int y = 10;

			int largeur_vie = (vie_j1 * barre_largeur) / VIE_MAX;

			//JOUERU1
			// Fond de la barre (gris clair)
			BSP_LCD_SetTextColor(LCD_COLOR_LIGHTGRAY);
			BSP_LCD_FillRect(x, y, barre_largeur, hauteur);

			// Vie restante (blanc)
			BSP_LCD_SetTextColor(LCD_COLOR_GREEN);
			BSP_LCD_FillRect(x, y, largeur_vie, hauteur);

			//JOUERU2
			int x2 = Dim_h - 10 - barre_largeur;
			int largeur_vie_j2 = (vie_j2 * barre_largeur) / VIE_MAX;

			// Fond (gris)
			BSP_LCD_SetTextColor(LCD_COLOR_LIGHTGRAY);
			BSP_LCD_FillRect(x2, y, barre_largeur, hauteur);

			// Vie restante (rouge)
			BSP_LCD_SetTextColor(LCD_COLOR_RED);
			BSP_LCD_FillRect(x2 + (barre_largeur - largeur_vie_j2), y, largeur_vie_j2, hauteur);

			//AFFICHAGE JOUEUR 1
			switch (etat_j1)
			{
			case 0:
				BSP_LCD_DrawBitmap(pos_x_j1, Dim_v - 10 - 80 - pos_y_j1, (uint8_t*)normal_bmp);
				break;
			case 1:
				BSP_LCD_DrawBitmap(pos_x_j1, Dim_v - 10 - 80- pos_y_j1, (uint8_t*)jaby_bmp);

				break;
			case 2:
				BSP_LCD_DrawBitmap(pos_x_j1, Dim_v - 10 -80- pos_y_j1, (uint8_t*)hadouken_bmp);
				break;

			default:
				BSP_LCD_DrawBitmap(pos_x_j1, Dim_v - 10 - 80- pos_y_j1, (uint8_t*)normal_bmp);
				break;
			}

			if (coup_j1_duree > 0)
			{
				coup_j1_duree--;
				if (coup_j1_duree == 0)
				{
					etat_j1 = 0;
					flamme_x_j1 =-1;
				}
			}

			// AFFICHAGE JOUEUR 2
			switch (etat_j2)
			{
			case 0:
				BSP_LCD_DrawBitmap(pos_x_j2, Dim_v - 10 - 80, (uint8_t*)normal2_bmp);
				break;
			case 1:
				BSP_LCD_DrawBitmap(pos_x_j2, Dim_v - 10 -80, (uint8_t*)jaby2_bmp);
				break;
			case 2:
				BSP_LCD_DrawBitmap(pos_x_j2, Dim_v - 10 -80, (uint8_t*)hadouken2_bmp);
				break;
			default:
				BSP_LCD_DrawBitmap(pos_x_j2, Dim_v - 10 - 80, (uint8_t*)normal2_bmp);
				break;
			}

			if (coup_j2_duree > 0)
			{
				coup_j2_duree--;
				if (coup_j2_duree == 0)
				{
					etat_j2 = 0;
					flamme_x_j2 =-1;
				}
			}

			// COLLISIONS DES COUPS

			// J1 touche J2
			if (etat_j1 == 1 && abs(pos_x_j1 - pos_x_j2) < PORTEE_COUP && !j2_KO) {
				if (vie_j2 > 0) {
					vie_j2 -= DEGATS_COUP;
					if (vie_j2 <= 0) {
						vie_j2 = 0;
						j2_KO = 1;
						jeu_termine = 1;
					}
				}
				etat_j1 = 0;
			}

			// J2 touche J1
			if (etat_j2 == 1 && abs(pos_x_j2 - pos_x_j1) < (PORTEE_COUP-20) && !j1_KO) {
				if (vie_j1 > 0) {
					vie_j1 -= DEGATS_COUP*2;
					if (vie_j1 <= 0) {
						vie_j1 = 0;
						j1_KO = 1;
						jeu_termine = 1;
					}
				}
				etat_j2 = 0;
			}

			//FLAMME :
			// FLAMME J1 (Hadouken)
			if (etat_j1 == 2 && coup_j1_duree > 0) {
				if (flamme_x_j1 == -1) {
					flamme_x_j1 = pos_x_j1 + SPRITE_WIDTH; // Départ du projectile
				} else {
					flamme_x_j1 += 5; // Vitesse de la flamme
					BSP_LCD_DrawBitmap(flamme_x_j1, Dim_v - 80, (uint8_t*)Flamme_bmp);
					if (flamme_x_j1 > Dim_h) {
						flamme_x_j1 = -1;
					}
				}

				// Collision Hadouken J1 touche J2
				if (abs(flamme_x_j1 - pos_x_j2) < (PORTEE_COUP-20) && !j2_KO) {
					vie_j2 -= DEGATS_COUP*2;
					if (vie_j2 <= 0) {
						vie_j2 = 0;
						j2_KO = 1;
						jeu_termine = 1;
					}
					flamme_x_j1 = -1;
					etat_j1 = 0;
					coup_j1_duree = 0;
				}
			}

			// FLAMME J2 (Hadouken)
			if (etat_j2 == 2 && coup_j2_duree > 0) {
				if (flamme_x_j2 == -1) {
					flamme_x_j2 = pos_x_j2 - SPRITE_WIDTH;
				} else {
					flamme_x_j2 -= 5;
					BSP_LCD_DrawBitmap(flamme_x_j2, Dim_v - 80, (uint8_t*)Flamme2_bmp);
					if (flamme_x_j2 < 0) {
						flamme_x_j2 = -1;
					}
				}

				// Collision Hadouken J2 touche J1
				if (abs(flamme_x_j2 - pos_x_j1) < PORTEE_COUP && !j1_KO) {
					vie_j1 -= DEGATS_COUP;
					if (vie_j1 <= 0) {
						vie_j1 = 0;
						j1_KO = 1;
						jeu_termine = 1;
					}
					flamme_x_j2 = -1;
					etat_j2 = 0;
					coup_j2_duree = 0;
				}
			}
			// Affiche "KO" si un joueur est mort
			if (j1_KO) {
				BSP_LCD_SetTextColor(LCD_COLOR_BLACK);
				BSP_LCD_DisplayStringAtLine(6, (uint8_t*)"JOUEUR 1 KO !");
			}

			if (j2_KO) {
				BSP_LCD_SetTextColor(LCD_COLOR_BLACK);
				BSP_LCD_DisplayStringAtLine(7, (uint8_t*)"JOUEUR 2 KO !");
			}
		}
		vTaskDelay(30);
	}
	/* USER CODE END Fonction_tache_affichage */
}

/* USER CODE BEGIN Application */
void copy_state(int envoi_reception){
	if (envoi_reception == ENVOI){
		envoi.joueur = 1;
		envoi.jeu_termine = jeu_termine;
		envoi.attente_relachement_BP = attente_relachement_BP;
		envoi.vie_j1 = 100;
		envoi.etat_j1 = etat_j1;
		envoi.pos_x_j1 = pos_x_j1;
		envoi.pos_y_j1 = pos_y_j1;
	}
	if(envoi_reception == RECEPTION){
		if ((reception.joueur) == 2){
			jeu_termine = reception.jeu_termine;
			attente_relachement_BP = reception.attente_relachement_BP;
			vie_j2 = reception.vie_j2;
			etat_j2 = reception.etat_j2;
			pos_x_j2 = reception.pos_x_j2;
			pos_y_j2 = reception.pos_y_j2;

		}

	}

}

/* USER CODE END Application */
